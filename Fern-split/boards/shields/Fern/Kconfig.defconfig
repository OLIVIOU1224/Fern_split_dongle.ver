## Fern-split/boards/shields/Fern/Kconfig.defconfig
```kconfig
# Copyright (c) 2024 The ZMK Contributors
# SPDX-License-Identifier: MIT

if SHIELD_FERN_LEFT

config ZMK_KEYBOARD_NAME
    default "Fern"
    
config ZMK_SPLIT_BLE_ROLE_CENTRAL
	default y

endif

if SHIELD_FERN_LEFT || SHIELD_FERN_RIGHT

config ZMK_SPLIT
    default y

endif
```

## Fern-split/boards/shields/Fern/Kconfig.shield
```kconfig
# Copyright (c) 2024 The ZMK Contributors
# SPDX-License-Identifier: MIT

config SHIELD_FERN_LEFT
    def_bool $(shields_list_contains,Fern_left)

config SHIELD_FERN_RIGHT
    def_bool $(shields_list_contains,Fern_right)
```

## boards/shields/Fern/Kconfig.defconfig
```kconfig
# Copyright (c) 2024 The ZMK Contributors
# SPDX-License-Identifier: MIT

if SHIELD_FERN_DONGLE

config ZMK_KEYBOARD_NAME
    default "Fern"
    
config ZMK_SPLIT_ROLE_CENTRAL
    default y

config ZMK_USB
    default y

endif


if SHIELD_FERN_LEFT || SHIELD_FERN_RIGHT || SHIELD_FERN_DONGLE

config ZMK_SPLIT
    default y

config ZMK_BLE
    default y

endif
```

## boards/shields/Fern/Kconfig.shield
```kconfig
# Copyright (c) 2024 The ZMK Contributors
# SPDX-License-Identifier: MIT

config SHIELD_FERN_LEFT
    def_bool $(shields_list_contains,Fern_left)

config SHIELD_FERN_RIGHT
    def_bool $(shields_list_contains,Fern_right)

config SHIELD_DONGLE_DISPLAY_091_OLED
    def_bool $(shields_list_contains,dongle_display_091_oled)
```

## config/west.yml
```yaml
manifest:
  remotes:
    - name: zmkfirmware
      url-base: https://github.com/zmkfirmware
  projects:
    - name: zmk
      remote: zmkfirmware
      revision: main
      import: app/west.yml
    # remote를 거치지 않고 url을 직접 입력합니다.
    - name: zmk-display-widgets
      url: https://github.com/caksoylar/zmk-display-widgets
      revision: main
  self:
    path: config
```
